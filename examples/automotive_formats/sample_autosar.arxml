AUTOSAR XML (schema 4-0-3)
package /ECU_Configuration
  ecu instance Engine_ECU: version=4.0.0  # Engine Control Unit with security vulnerabilities
  security module Missing_CSM: status=NOT_IMPLEMENTED
  crypto module Missing_CRYPTO: status=NOT_IMPLEMENTED
  secoc module Missing_SECOC: status=NOT_IMPLEMENTED
  fim module Missing_FIM: status=NOT_IMPLEMENTED
  vulnerable function strcpy_usage: function-name=process_can_message, security-level=VULNERABLE
  hardcoded credentials admin_password: value=admin123, security-level=CRITICAL
