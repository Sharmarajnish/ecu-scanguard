AUTOSAR XML (schema 4-0-3)
package /ECU_Configuration
  ecu instance EngineControlUnit  # Engine Control Unit Configuration
    communication connector CAN_Communication: communication-interface=CAN_Interface
  communication interface CAN_Interface: communication-interface=CAN_Interface  # CAN Communication Interface
  software-components:
    application sw component type EngineControlApp  # Engine Control Application
      require port EngineDataPort: required-interface=EngineDataInterface
